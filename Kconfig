## Kconfig
```kconfig
#
# For a description of the syntax of this configuration file,
# see the file kconfig-language.txt in the NuttX tools repository.
#

config EXTERNAL_CURL
	bool "CURL library"
	default n
	select LIBC_SCANSET
	select LIBC_LOCALTIME
	---help---
		Enables the CURL library.
```
